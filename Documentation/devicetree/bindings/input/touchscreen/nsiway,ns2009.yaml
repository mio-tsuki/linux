## Documentation/devicetree/bindings/input/touchscreen/nsiway,ns2009.yaml
```yaml
# SPDX-License-Identifier: (GPL-2.0-only OR BSD-2-Clause)
%YAML 1.2
---
$id: http://devicetree.org/schemas/input/touchscreen/nsiway,ns2009.yaml#
$schema: http://devicetree.org/meta-schemas/core.yaml#

title: Nsiway NS2009 resistive touchscreen controller

maintainers:
  - Mizuno Miotsuki <founder@crepuse.com>

description:
  Nsiway NS2009 is an I2C four-wire resistive touchscreen controller with
  a 12-bit ADC, an active-low pen interrupt and touch resistance measurement.

allOf:
  - $ref: touchscreen.yaml#

properties:
  compatible:
    const: nsiway,ns2009

  reg:
    maxItems: 1

  interrupts:
    maxItems: 1
    description:
      Active-low pen interrupt output. Optional when the signal is not
      connected.

  wakeup-source:
    type: boolean

  vdd-supply:
    description: Main power supply.

  vref-supply:
    description: External ADC reference voltage supply.

  touchscreen-min-pressure:
    minimum: 1
    maximum: 4095
    default: 80
    description:
      Minimum raw Z1 reading considered a touch. This is a contact detection
      threshold, not a calibrated pressure value. Boards may require a higher
      empirically determined threshold than the historical driver default.

required:
  - compatible
  - reg
  - vdd-supply

unevaluatedProperties: false

examples:
  - |
    #include <dt-bindings/interrupt-controller/irq.h>

    i2c {
        #address-cells = <1>;
        #size-cells = <0>;

        touchscreen@48 {
            compatible = "nsiway,ns2009";
            reg = <0x48>;
            interrupt-parent = <&gpio1>;
            interrupts = <7 IRQ_TYPE_LEVEL_LOW>;
            wakeup-source;
            vdd-supply = <&vdd>;
            vref-supply = <&vref>;
            touchscreen-x-plate-ohms = <400>;
            touchscreen-min-pressure = <150>;
            touchscreen-max-pressure = <4095>;
            touchscreen-fuzz-pressure = <16>;
            touchscreen-inverted-y;
        };
    };
```
